## boards/shields/tbk/Kconfig.defconfig
```kconfig
if SHIELD_TBK_LEFT

# Name must be less than 16 characters long!
config ZMK_KEYBOARD_NAME
    default "TBK-Mini"

config ZMK_SPLIT_ROLE_CENTRAL
    default y

endif

if SHIELD_TBK_LEFT || SHIELD_TBK_RIGHT

config ZMK_SPLIT
    default y

endif
```

## boards/shields/tbk/Kconfig.shield
```kconfig
# No whitespace after the comma or in your part name!
config SHIELD_TBK_LEFT
    def_bool $(shields_list_contains,tbk_left)

# No whitespace after the comma or in your part name!
config SHIELD_TBK_RIGHT
    def_bool $(shields_list_contains,tbk_right)
```
